## arch/arm/mach-thunderbay/Kconfig
```kconfig
if ARCH_THB

config TARGET_THB_SOC
	bool "Support Thunder Bay Platform"
	help
	  Support for Thunder Bay platform.

config SYS_BOARD
	default "thb-soc" if TARGET_THB_SOC

config SYS_CONFIG_NAME
	default "thb-soc" if TARGET_THB_SOC

config SYS_VENDOR
	default "intel"

config SYS_SOC
	default "thb"

config THUNDERBAY_SDHCI_MAX_FREQ
	int "Sets the maximum frequency of the controller"
	depends on MMC_SDHCI_THUNDERBAY
	default 200000000

config THUNDERBAY_SDHCI_MIN_FREQ
	int "Sets the minimum frequency of the controller"
	depends on MMC_SDHCI_THUNDERBAY
	default 0
	help
	  Set the minimum frequency of the controller. If 0, the value
	  will be calculated as max divided by maximum divider.

config THUNDERBAY_SDHCI_ENABLE_HS
	bool "Enables high speed mode in the controller."
	default y

config THUNDERBAY_SDHCI_ENABLE_SDR50
	bool "Enables SDR50 mode in the controller."
	default y

config THUNDERBAY_SDHCI_ENABLE_DDR50
	bool "Enables DDR50 mode in the controller."
	default y

config THUNDERBAY_SDHCI_ENABLE_SDR104
	bool "Enables SDR104 mode in the controller."
	default y

config THUNDERBAY_SDHCI_ENABLE_HS400
	bool "Enables HS400 mode in the controller."
	default y

config THUNDERBAY_PCIE_EP_MISC_VPU_BOOT
	bool "Enable PCIe EP Misc VPU Boot driver on Thunder Bay Platform"
	help
	  Enable PCIe boot MISC driver to interface with PCIe
	  hardware on Thunder Bay platform. Provides functions to
	  read from and write to the communication BAR with the
	  host. Provides methods of setting up and changing the
	  communication BAR location in local memory, as well as
	  performing DMA transactions from host memory to local
	  memory.

config CMD_THUNDERBAY_PCIE_BOOT
	bool "Enable PCIe command boot on Thunder Bay Platform"
	help
	  Enable PCIe boot command on Thunder Bay Platform

config CMD_THUNDERBAY_PCIE_RECOVERY_MMC
        bool "Enable PCIe command to recover eMMC on ThunderBay Platform"
        depends on MMC
        help
          Enable the PCIe eMMC command to recover the GPT, OS and file system
          by flashing individual partitions based on commands given from the
          host.

config PCIE_RECOVERY_MMC_DEV
        int "Define PCIe MMC FLASH default device"
        depends on CMD_THUNDERBAY_PCIE_RECOVERY_MMC
        help
          The PCIe eMMC recovery boot requires information on the flash device
          to store the images received.

config CMD_THUNDERBAY_CLOCK_DEBUG_CONFIG
	bool "Enable clock debug command on Thunder Bay Platform"
	help
	  Enable clock debug command on Thunder Bay Platform. The
	  command accepts one argument which is the address of
	  the clock message to be sent to the secure world, which
	  behaves like an SCP. It will be printed out on screen

endif
```

## board/intel/thb-soc/Kconfig
```kconfig
if TARGET_THB_SOC

config SYS_CONFIG_NAME
	default "thb-soc"

config ENABLE_MENDER
	bool "Enable mender.io support in U-Boot for Thunder Bay"
	help
	  Enable this option to apply the changes to U-Boot required to
	  support mender.io operation on Thunder Bay.

config THUNDERBAY_EMULATION
	bool "Enable FPGA-specific changes"
	default y

config CMD_VPU_BOOT
	bool "Enable 'vpu' command"
	depends on ARM_SMCCC
	help
	  A test-only command to trigger the boot of an VPU firmware
	  loaded at a configurable location.

config THUNDERBAY_MEM_PROTECT
	bool "Enable Thunder Bay Memory protection."
	default y
	select BOARD_EARLY_INIT_R
	help
	  When enabled, U-Boot sets up a set of Isolated Memory Regions (IMRs)
	  to protect critical assets in RAM (e.g., the Linux Kernel, the Device
	  Tree, etc.).

config  PLATFORM_THUNDERBAY
        bool "Enable support for Thunderbay Platform"
	help
          Enable support for Thunderbay Platform
        default n
endif
```

## board/intel/thb-soc/thb-os-image.its
```
/dts-v1/;

/ {
	description = "Thunder Bay OS image";
	#address-cells = <2>;

	images {
		kernel-1 {
			description = "ThunderBay Linux Kernel";
			data = /incbin/("thb-kernel");
			type = "kernel";
			arch = "arm64";
			os = "linux";
			compression = "none";
			load =  <0x00000010 0x90080000>; /* These are temporary working values */
			entry = <0x00000010 0x90080000>; /* Needs to be updated with actual value */
			hash-1 {
				algo = "sha384";
			};
		};
	};

	configurations {
		default = "conf-1";
		conf-1 {
			description = "Boot ThunderBay Linux Kernel";
			svn = <0>;
			kernel = "kernel-1";
			signature-1 {
				algo = "sha384,ecdsa384";
				key-name-hint = "devel-key";
				sign-images = "kernel";
			};
		};
	};
};
```

## configs/thb_vp_defconfig
```kconfig
CONFIG_ARM=y
CONFIG_ARM_SMCCC=y
CONFIG_ARCH_THB=y
CONFIG_SYS_TEXT_BASE=0x1008000000
CONFIG_PLATFORM_THUNDERBAY=y
CONFIG_TARGET_THB_SOC=y
CONFIG_DEBUG_UART_BASE=0x80460000
CONFIG_DEBUG_UART_CLOCK=50000000
CONFIG_IDENT_STRING=" Thunder Bay "
CONFIG_SYS_BOARD="thb-soc"
CONFIG_SYS_CONFIG_NAME="thb-soc"
CONFIG_DEBUG_UART=y
CONFIG_DISTRO_DEFAULTS=y
CONFIG_NR_DRAM_BANKS=1
CONFIG_OF_BOARD_SETUP=y
CONFIG_SD_BOOT=y
CONFIG_PCIE_RECOVERY_MMC_DEV=0
CONFIG_CMD_THUNDERBAY_PCIE_RECOVERY_MMC=y
# CONFIG_DISPLAY_CPUINFO is not set
CONFIG_BOARD_EARLY_INIT_F=y
CONFIG_DM_VERITY=y
CONFIG_SYS_PROMPT="thb# "
CONFIG_MMC=y
CONFIG_DM_MMC=y
CONFIG_CMD_MMC=y
CONFIG_CMD_EXT4_WRITE=y
CONFIG_CMD_DM=y
# CONFIG_ISO_PARTITION is not set
CONFIG_PARTITION_TYPE_GUID=y
CONFIG_DEFAULT_DEVICE_TREE="thb_u-boot"
CONFIG_BOOTCOUNT_LIMIT=y
CONFIG_BOOTCOUNT_ENV=y
CONFIG_ENV_IS_IN_MMC=y
CONFIG_SYS_REDUNDAND_ENVIRONMENT=y
CONFIG_ENV_OFFSET=0x2100000
CONFIG_ENV_OFFSET_REDUND=0x2180000
CONFIG_ENV_SIZE=0x80000
CONFIG_CLK=y
CONFIG_CLK_THUNDERBAY_FIXED=y
CONFIG_DM_MMC=y
CONFIG_MMC_SDHCI=y
# CONFIG_MMC_SDHCI_SDMA is not set
# CONFIG_MMC_SDHCI_ADMA64 is not set
CONFIG_MMC_SDHCI_THUNDERBAY=y
#CONFIG_MMC_HS200_SUPPORT
CONFIG_BAUDRATE=115200
CONFIG_DEBUG_UART_SHIFT=2
CONFIG_DEBUG_UART_ANNOUNCE=y
CONFIG_FAT_WRITE=y
CONFIG_FIT=y
CONFIG_FIT_ENABLE_SHA384_SUPPORT=y
CONFIG_FIT_SIGNATURE=y
CONFIG_FIT_SVN=n
CONFIG_THUNDERBAY_PCIE_EP_MISC_VPU_BOOT=y
CONFIG_CMD_THUNDERBAY_PCIE_BOOT=y
CONFIG_THUNDERBAY_PCIEBOOT_BUF_ADDR=0x101A200000
CONFIG_THUNDERBAY_PCIEBOOT_BUF_SIZE=0x10000
CONFIG_MISC=y
CONFIG_CMD_GPT=y
CONFIG_PARTITION_UUIDS=y
CONFIG_EFI_PARTITION=y
# Legacy image format is needed to support raw initramfs images (i.e.,
# initramfs images not encapsulated in FIT images).
# TODO: Remove legacy image support once initramfs image is not needed anymore.
CONFIG_IMAGE_FORMAT_LEGACY=y
CONFIG_LEGACY_IMAGE_FORMAT=y
CONFIG_ECDSA=y
CONFIG_XMSS=y
# Disable RSA which is enabled by default when CONFIG_FIT_SIGNATURE is enabled
CONFIG_RSA=n
CONFIG_SYS_MALLOC_F_LEN=0x800
CONFIG_SPI=y
CONFIG_DESIGNWARE_SPI=y
CONFIG_CMD_SPI=y
CONFIG_CMD_SF=y
CONFIG_CMD_TPM=y
CONFIG_CMD_TPM_TEST=y
CONFIG_DM_SPI=y
CONFIG_DM_SPI_FLASH=y
CONFIG_TPM2_TIS_SPI=y
CONFIG_TPM=y
# CONFIG_THUNDERBAY_SDHCI_ENABLE_HS is not set
# CONFIG_THUNDERBAY_SDHCI_ENABLE_HS400 is not set
# CONFIG_THUNDERBAY_SDHCI_ENABLE_SDR104 is not set
# CONFIG_THUNDERBAY_SDHCI_ENABLE_DDR50 is not set
# CONFIG_THUNDERBAY_SDHCI_ENABLE_SDR50 is not set
CONFIG_SPI_FLASH=y
CONFIG_SPI_FLASH_STMICRO=y
CONFIG_DM_GPIO=y
#CONFIG_INTEL_THB_GPIO=y
CONFIG_TEE=y
CONFIG_OPTEE=y
CONFIG_TEE_CLIENT_API=y
CONFIG_SUPPORT_EMMC_RPMB=y
#CONFIG_SYS_REDUNDAND_ENVIRONMENT=y
CONFIG_RANDOM_UUID=y
CONFIG_LIB_RAND=y
CONFIG_TPM_V2=y
CONFIG_TPM_V1=n
CONFIG_CMD_TPM_V2=y
CONFIG_CMD_TPM_V1=n
CONFIG_TPM2_FTPM_OPTEE=n
# USB-related configs (TODO: make Vid/Pid dynamic)
#CONFIG_USB=y
#CONFIG_USB_DWC3=y
#CONFIG_USB_DWC3_GADGET=y
#CONFIG_USB_GADGET=y
#CONFIG_USB_GADGET_MANUFACTURER="Intel"
#CONFIG_USB_GADGET_VENDOR_NUM=0x8087
#CONFIG_USB_GADGET_PRODUCT_NUM=0xb007
#CONFIG_USB_GADGET_DOWNLOAD=y
# Fastboot-related configs
#CONFIG_CMD_FASTBOOT=y
#CONFIG_FASTBOOT=y
#CONFIG_USB_FUNCTION_FASTBOOT=y
#CONFIG_FASTBOOT_BUF_ADDR=0x90000000
#CONFIG_FASTBOOT_BUF_SIZE=0x60000000
#CONFIG_FASTBOOT_USB_DEV=0
CONFIG_ENABLE_MENDER=y
# CONFIG LOG
CONFIG_LOG=y
CONFIG_LOG_MAX_LEVEL=6
CONFIG_LOGLEVEL=7
#CONFIG_BOOTCOMMAND="run $bootcmd"
CONFIG_BOOTDELAY=10
CONFIG_CMD_THUNDERBAY_FUSE_PROVISION=y
```

## drivers/crypto/ocs_hash/Kconfig
```kconfig
config SHA1_HW_ACCEL
	bool "HW acceleration for SHA1"
	depends on SHA_HW_ACCEL
	default y
	help
	  Say yes here to support HW acceleration on SHA1
	  Hardware acceleration on SHA1 simple hash only, select
	  SHA1_PROG_HW_ACCEL for support on SHA1 progressive hash.

config SHA256_HW_ACCEL
	bool "HW acceleration for SHA256"
	depends on SHA_HW_ACCEL
	default y
	help
	  Say yes here to support HW acceleration on SHA256
	  Hardware acceleration on SHA256 simple hash only, select
	  SHA256_PROG_HW_ACCEL for support on SHA256 progressive hash.

config SHA384_HW_ACCEL
	bool "HW acceleration for SHA384"
	depends on SHA_HW_ACCEL
	default n
	help
	  Say yes here to support HW acceleration on SHA384
	  Hardware acceleration on SHA384 simple hash only, select
	  SHA384_PROG_HW_ACCEL for support on SHA256 progressive hash.

config SHA512_HW_ACCEL
	bool "HW acceleration for SHA512"
	depends on SHA_HW_ACCEL
	default n
	help
	  Say yes here to support HW acceleration on SHA512
	  Hardware acceleration on SHA512 simple hash only, select
	  SHA512_PROG_HW_ACCEL for support on SHA512 progressive hash.

config SHA1_PROG_HW_ACCEL
	bool "Enable HW Progressive hashing support for SHA1"
	depends on SHA_PROG_HW_ACCEL
	default y
	help
	  This option enables hardware-acceleration for
	  SHA1 progressive hashing.
	  Data can be streamed in a block at a time and the hashing
	  is performed in hardware.

config SHA256_PROG_HW_ACCEL
	bool "Enable HW Progressive hashing support for SHA256"
	depends on SHA_PROG_HW_ACCEL
	default y
	help
	  This option enables hardware-acceleration for
	  SHA256 progressive hashing.
	  Data can be streamed in a block at a time and the hashing
	  is performed in hardware.

config SHA384_PROG_HW_ACCEL
	bool "Enable HW Progressive hashing support for SHA384"
	depends on SHA_PROG_HW_ACCEL
	default n
	help
	  This option enables hardware-acceleration for
	  SHA384 progressive hashing.
	  Data can be streamed in a block at a time and the hashing
	  is performed in hardware.

config SHA512_PROG_HW_ACCEL
	bool "Enable HW Progressive hashing support for SHA512"
	depends on SHA_PROG_HW_ACCEL
	default n
	help
	  This option enables hardware-acceleration for
	  SHA512 progressive hashing.
	  Data can be streamed in a block at a time and the hashing
	  is performed in hardware.

config OCS_HW_HASH
	bool "OCS Hash HW Acceleration"
	depends on DM
	depends on ARCH_KMB
	select SHA256
	select SHA384
	select SHA512
	select SHA256_HW_ACCEL
	select SHA384_HW_ACCEL
	select SHA512_HW_ACCEL
	select SHA256_PROG_HW_ACCEL
	select SHA384_PROG_HW_ACCEL
	select SHA512_PROG_HW_ACCEL
	help
	  Enables the Offload Crypto Subsystem (OCS) hash HW acceleration on
	  SHA256, SHA384 and SHA512.
	  The driver uses ATF secure world services to invoke OCS hash APIs.
```

## lib/crypto/Kconfig
```kconfig
menuconfig ASYMMETRIC_KEY_TYPE
	bool "Asymmetric (public-key cryptographic) key Support"
	help
	  This option provides support for a key type that holds the data for
	  the asymmetric keys used for public key cryptographic operations such
	  as encryption, decryption, signature generation and signature
	  verification.

if ASYMMETRIC_KEY_TYPE

config ASYMMETRIC_PUBLIC_KEY_SUBTYPE
	bool "Asymmetric public-key crypto algorithm subtype"
	help
	  This option provides support for asymmetric public key type handling.
	  If signature generation and/or verification are to be used,
	  appropriate hash algorithms (such as SHA-1) must be available.
	  ENOPKG will be reported if the requisite algorithm is unavailable.

config RSA_PUBLIC_KEY_PARSER
	bool "RSA public key parser"
	depends on ASYMMETRIC_PUBLIC_KEY_SUBTYPE
	select ASN1_DECODER
	select ASN1_COMPILER
	select OID_REGISTRY
	help
	  This option provides support for parsing a blob containing RSA
	  public key data and provides the ability to instantiate a public
	  key.

config X509_CERTIFICATE_PARSER
	bool "X.509 certificate parser"
	depends on ASYMMETRIC_PUBLIC_KEY_SUBTYPE
	select ASN1_DECODER
	select ASN1_COMPILER
	select OID_REGISTRY
	select LIB_DATE
	help
	  This option provides support for parsing X.509 format blobs for key
	  data and provides the ability to instantiate a crypto key from a
	  public key packet found inside the certificate.

config PKCS7_MESSAGE_PARSER
	bool "PKCS#7 message parser"
	depends on X509_CERTIFICATE_PARSER
	select ASN1_DECODER
	select ASN1_COMPILER
	select OID_REGISTRY
	help
	  This option provides support for parsing PKCS#7 format messages for
	  signature data and provides the ability to verify the signature.

config PKCS7_VERIFY
	bool

endif # ASYMMETRIC_KEY_TYPE
config ECDSA
	bool "Use ECDSA Library"
	imply ECDSA_ENGINE_THUNDERBAY
	select ECDSA_ENGINE_SW if !ECDSA_ENGINE_THUNDERBAY
	help
	  ECDSA support. This option enables ECDSA authentication for FIT image
	  verification in U-Boot. This option can be enabled only on the Thunder
	  Bay platform (since the code depends on Thunder Bay crypto hardware).
	  Nevertheless, ECDSA support is added to mkimage regardless of this
	  option.  The only ECDSA variant currently supported is ECDSA-384.

if ECDSA

config SPL_ECDSA
	bool "Use ECDSA Library within SPL"
	help
	  Enable Elliptic Curve Digital Signature Algorithm (ECDSA) support
	  also in U-Boot SPL.

config ECDSA_ENGINE_SW
	bool "Enable driver for software ECDSA engine"
	depends on DM
	help
	  Enable software engine for performing ECDSA crypto operations. Note:
	  currently, this driver is just a stub.

config ECDSA_ENGINE_THUNDERBAY
	bool "Enable driver for Thunder Bay ECDSA engine"
	depends on DM && ARCH_THB
	help
	  Enable Thunder Bay ECDSA engine for performing ECDSA crypto operations
	  in hardware.

endif

config XMSS
	bool "Use XMSS Library"
	imply XMSS_ENGINE_THUNDERBAY
	select XMSS_ENGINE_SW if !XMSS_ENGINE_THUNDERBAY
	help
	  XMSS support. This option enables eXtended Merkle Signature Scheme
	  (XMSS) authentication for FIT image verification in U-Boot. This
	  option can be enabled only on the Thunder Bay platform (since the code
	  depends on Thunder Bay crypto hardware). When XMSS is enabled, XMSS
	  support is also added to 'mkimage'; this requires the use of a
	  modified version of OpenSSL providing XMSS support.

if XMSS

config SPL_XMSS
	bool "Use XMSS Library within SPL"
	help
	  Enable eXtended Merkle Signature Scheme (XMSS) support also in U-Boot
	  SPL.

config XMSS_ENGINE_SW
	bool "Enable driver for software XMSS engine"
	depends on DM
	help
	  Enable software engine for performing XMSS crypto operations. Note:
	  currently, this driver is just a stub.

config XMSS_ENGINE_THUNDERBAY
	bool "Enable driver for Thunder Bay XMSS engine"
	depends on DM && ARCH_THB
	help
	  Enable Thunder Bay XMSS hardware engine for performing XMSS crypto
	  operations in hardware.

# TODO: remove the following config option once XMSS support has been added to
# upstream OpenSSL.
config XMSS_OPENSSL_DIR
	string "The patch to the compiled XMSS OpenSSL library"
	default "../openssl"
	help
	  Specify the path to the directory containing the compiled static
	  OpenSSL library with XMSS support.  The directory must also contain
	  the library header files, under the 'include' sub-directory.

endif
```
